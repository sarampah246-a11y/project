/*
 * this file is ued to change sprd dtsi which can't be changed by overlay
 * such as /delete-node/ /delete-property/ and alises
 */
#include "zte_charger_chestnut.dtsi"
#include "zte_touchscreen_chestnut.dtsi"
#include "zte_camera_chestnut.dtsi"
#include "zte_thermal.dtsi"
