/{
	zte_tp:zte_tp {
		compatible = "zte_tp";
		zte,tp_algo;
		zte,tp_long_press;
		zte,tp_long_press_timer = <800>;
		zte,tp_long_press_left_v = <12>;
		zte,tp_long_press_right_v = <12>;
		zte,tp_long_press_left_h = <16>; /*camera */
		zte,tp_long_press_right_h = <12>; /*charger */
		zte,tp_edge_click_suppression_pixel = <2>;
	};
};

&i2c3 {
	clock-frequency = <400000>;
	status = "okay";

	tlsc6x_ts@2e {
		compatible = "tlsc6x,tlsc6x_ts";
		reg = <0x2e>;
		gpios = <&ap_gpio 145 0
			&ap_gpio 144 0
			&ap_gpio 85 0>;
		TP_MAX_X = <479>;
		TP_MAX_Y = <959>;
	};
};
