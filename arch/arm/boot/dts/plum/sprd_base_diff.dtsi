/*
 * this file is ued to change sprd dtsi which can't be changed by overlay
 * such as /delete-node/ /delete-property/ and alises
 */

#include "touchscreen_plum.dtsi"
//#include "zte_lcd.dtsi"
#include "zte_charger_plum.dtsi"
#include "zte_camera_plum.dtsi"
#include "zte_thermal_plum.dtsi"




