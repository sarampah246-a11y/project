&dphy {
	/delete-property/ sprd,ulps-disabled;
};

/*
&i2c4 {
	ti65132b@3e {
		compatible = "tps,ti65132b";
		reg = <0x3e>;
	};
};*/

&panel {
	/*sprd,surface-width = <720>;
	sprd,surface-height = <1600>;*/
	avdd-gpio = <&ap_gpio 4 GPIO_ACTIVE_HIGH>;
	avee-gpio = <&ap_gpio 5 GPIO_ACTIVE_HIGH>;
	reset-gpio = <&ap_gpio 50 GPIO_ACTIVE_HIGH>;
};
