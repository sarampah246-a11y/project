/*
 * this file is ued to change sprd dtsi which can't be changed by overlay
 * such as /delete-node/ /delete-property/ and alises
 */
#include "zte_charger_gingko.dtsi"
#include "zte_touchscreen_gingko.dtsi"
#include "zte_fingerprint_gingko.dtsi"
#include "zte_nfc_gingko.dtsi"



