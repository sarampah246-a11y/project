/*
 * this file is ued to change sprd dtsi which can't be changed by overlay
 * such as /delete-node/ /delete-property/ and alises
 */

#include "touchscreen_tulip.dtsi"
#include "zte_fingerprint_tulip.dtsi"
#include "zte_camera_tulip.dtsi"
#include "zte_charger_tulip.dtsi"
#include "zte_leds_tulip.dtsi"
#include "zte_sar_tulip.dtsi"
#include "zte_audio_tulip.dtsi"

/{
	zcard_holder_det {
		zcard-holder-det-gpios= <&eic_sync 36 GPIO_ACTIVE_HIGH>;
	};
};

