&spi3 {
	status = "ok";
	#address-cells = <1>;
	#size-cells = <0>;
	zte-ts@0 {
		compatible = "chipone-tddi", "focaltech,fts";
		reg = <0>;
		spi-max-frequency = <9600000>;

		chipone,irq-gpio = <&eic_async 16 0x2008>; /* IRQF_ONESHOT | IRQF_TRIGGER_LOW */
 		chipone,rst-gpio = <&ap_gpio 145 0x0000>;
 		chipone,x-res = <719>;
 		chipone,y-res = <1611>;
		focaltech,reset-gpio = <&ap_gpio 145 0x0000>;
		focaltech,irq-gpio =  <&eic_async 16 0x2008>; /* IRQF_ONESHOT | IRQF_TRIGGER_LOW */
		focaltech,display-coords = <0 0 719 1611>;
		focaltech,max-touch-number = <10>;
 	};
 };
 
 /{
	zte_tp:zte_tp {
		compatible = "zte_tp";
		zte,tp_algo;
		zte,tp_long_press;
		zte,tp_long_press_timer = <800>;
		zte,tp_long_press_left_v = <15>;
		zte,tp_long_press_right_v = <15>;
		zte,tp_long_press_left_h = <20>; /*camera */
		zte,tp_long_press_right_h = <15>; /*charger */
		zte,tp_edge_click_suppression_pixel = <3>;
	};
};
