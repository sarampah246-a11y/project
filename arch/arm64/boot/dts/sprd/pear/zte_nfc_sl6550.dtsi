&i2c2 {
	status = "okay";
        clock-frequency = <400000>;
        #address-cells = <1>;
        #size-cells = <0>;
        nfc_pn5xx: pn544@28 {
                compatible = "nxp,pn544";
                reg = <0x28>;
                interrupt-parent = <&ap_gpio>;
                interrupts = <165 0>;
                nxp,pn544-irq = <&ap_gpio 54 0>;
                nxp,pn544-clkreq = <&ap_gpio 55 0>;
                nxp,pn544-ven = <&ap_gpio 63 0>;
                nxp,pn544-fw-dwnld = <&ap_gpio 62 0>;
        };
};
